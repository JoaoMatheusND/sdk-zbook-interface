## interface/Kconfig
```kconfig
menu "ZBook Interface"

rsource "Kconfig.actuators"
rsource "Kconfig.io"
rsource "Kconfig.protocols"
rsource "Kconfig.sensors"
rsource "Kconfig.storage"

endmenu
```

## interface/Kconfig.actuators
```kconfig
menu "ZBook Interface - Actuators"

config ZBOOK_INTERFACE_ACTUATORS
    bool "Enable ZBook Interface Actuators"
    default n
    help
      Enable the ZBook Interface Actuators module.

endmenu
```

## interface/Kconfig.protocols
```kconfig
menu "ZBook Interface - Protocols"

config ZBOOK_INTERFACE_PROTOCOLS
    bool "Enable ZBook Interface Protocols"
    default n
    help
      Enable the ZBook Interface Protocols module.

endmenu
```

## interface/Kconfig.sensors
```kconfig
menu "ZBook Interface - Sensors"

config ZBOOK_INTERFACE_SENSORS
    bool "Enable ZBook Interface Sensors"
    default n
    help
      Enable the ZBook Interface Sensors module.

    menu "ZBook LDR Sensor"
        depends on ZBOOK_INTERFACE_SENSORS

        config ZBOOK_INTERFACE_SENSORS_LDR
            bool "Enable ZBook LDR sensor"
            default y
            select ADC
            depends on ZBOOK_INTERFACE_SENSORS
            help
                Enable zbook_ldr_init/read, a pure-C passthrough over the Zephyr ADC
                driver bound to the ldr_adc devicetree node.

        config ZBOOK_INTERFACE_SENSORS_POTENTIOMETER
          	bool "ZBook potentiometer sensor interface"
            depends on ZBOOK_INTERFACE_SENSORS
          	select ADC
            default y
          	help
          	  Enable zbook_potentiometer_init/read, a pure-C passthrough over the Zephyr ADC
          	  driver bound to the potentiometer devicetree node.
    endmenu
endmenu

if ZBOOK_INTERFACE_SENSORS_LDR
    module = LDR
    module-str = ldr
    source "subsys/logging/Kconfig.template.log_config"
endif

if ZBOOK_INTERFACE_SENSORS_POTENTIOMETER
    module = POTENTIOMETER
    module-str = potentiometer
    source "subsys/logging/Kconfig.template.log_config"
endif
```

## interface/Kconfig.storage
```kconfig
menu "ZBook Interface - Storage"

config ZBOOK_INTERFACE_STORAGE
    bool "Enable ZBook Interface Storage"
    default n
    help
      Enable the ZBook Interface Storage module.

endmenu
```

## interface/samples/actuators/zbook_buzzer_shell/sample.yaml
```yaml
sample:
  name: ZBook buzzer shell
  description: >
    Bring-up sample exposing the zbook piezo buzzer actuator (on/off/volume/
    frequency/beep/music) as shell commands, for manually validating the
    onboard buzzer on real P2 hardware over the console.
tests:
  sample.actuators.buzzer:
    tags:
      - samples
      - interface
      - actuators
      - buzzer
    platform_allow:
      - zbook@p2/rp2350b/m33
    build_only: true
```
