## prj.conf
```kconfig
CONFIG_ZTEST=y
CONFIG_ZBOOK_INTERFACE_PROTOCOLS=y
CONFIG_ZBOOK_INTERFACE_PROTOCOLS_I2C=y
CONFIG_ASSERT=y
CONFIG_ZTEST_ASSERT_HOOK=y
```

## src/main.c
```c
/*******************************************************************
 * @file main.c
 *
 * @brief Unit tests for the zbook I2C bus interface.
 * @author Matheus Macário dos Santos (matheus.macario@edge.ufal.br)
 * @version 0.1
 * @date 18/09/2026
 *
 * @copyright Copyright (c) Centro de Inovacao EDGE - 2026
 *
 *******************************************************************/

#include <errno.h>
#include <zephyr/ztest.h>
#include <zephyr/ztest_error_hook.h>
#include <protocols/zbook_i2c.h>

#include "zbook_i2c_loopback_emul.h"

/* Matches boards/native_sim.overlay's zbook_i2c_target@50 */
#define ZBOOK_I2C_TEST_ADDR 0x50

/* Reserved by the I2C spec (0x78-0x7F), no device answers on it */
#define ZBOOK_I2C_RESERVED_ADDR 0x7F

ZTEST_SUITE(zbook_i2c, NULL, NULL, NULL, NULL, NULL);

void ztest_post_assert_fail_hook(void)
{
	ztest_test_pass();
}

ZTEST(zbook_i2c, test_00_read_before_init_asserts)
{
	uint8_t byte = 0;

	ztest_set_assert_valid(true);
	zbook_i2c_read(ZBOOK_I2C_TEST_ADDR, &byte, sizeof(byte));
	ztest_test_fail();
}

ZTEST(zbook_i2c, test_00a_configure_before_init_asserts)
{
	struct zbook_i2c_cfg cfg = {.speed = ZBOOK_I2C_SPEED_STANDARD_100K};

	ztest_set_assert_valid(true);
	zbook_i2c_configure(&cfg);
	ztest_test_fail();
}

ZTEST(zbook_i2c, test_01_init_ok)
{
	zassert_ok(zbook_i2c_init());
}

ZTEST(zbook_i2c, test_configure_invalid_args)
{
	struct zbook_i2c_cfg cfg = {.speed = (enum zbook_i2c_speed)99};

	zassert_equal(-EINVAL, zbook_i2c_configure(NULL));
	zassert_equal(-EINVAL, zbook_i2c_configure(&cfg));
}

ZTEST(zbook_i2c, test_configure_accepts_every_supported_speed)
{
	const enum zbook_i2c_speed speeds[] = {
		ZBOOK_I2C_SPEED_STANDARD_100K,
		ZBOOK_I2C_SPEED_FAST_400K,
		ZBOOK_I2C_SPEED_FAST_PLUS_1M,
	};

	for (size_t i = 0; i < ARRAY_SIZE(speeds); i++) {
		const struct zbook_i2c_cfg cfg = {.speed = speeds[i]};

		zassert_ok(zbook_i2c_configure(&cfg), "configure(speed=%d) failed", speeds[i]);
	}
}

ZTEST(zbook_i2c, test_write_invalid_args)
{
	uint8_t byte = 0;

	zassert_equal(-EINVAL, zbook_i2c_write(ZBOOK_I2C_TEST_ADDR, NULL, 1));
	zassert_equal(-EINVAL, zbook_i2c_write(ZBOOK_I2C_TEST_ADDR, &byte, 0));
}

ZTEST(zbook_i2c, test_write_captures_bytes)
{
	uint8_t tx[3] = {0x01, 0x02, 0x03};
	uint8_t captured[3] = {0};

	zbook_i2c_test_emul_reset();
	zassert_ok(zbook_i2c_write(ZBOOK_I2C_TEST_ADDR, tx, sizeof(tx)));
	zassert_equal(sizeof(tx), zbook_i2c_test_emul_last_write(captured, sizeof(captured)));
	zassert_mem_equal(tx, captured, sizeof(tx));
}

ZTEST(zbook_i2c, test_read_invalid_args)
{
	uint8_t byte = 0;

	zassert_equal(-EINVAL, zbook_i2c_read(ZBOOK_I2C_TEST_ADDR, NULL, 1));
	zassert_equal(-EINVAL, zbook_i2c_read(ZBOOK_I2C_TEST_ADDR, &byte, 0));
}

ZTEST(zbook_i2c, test_read_returns_canned_pattern)
{
	uint8_t rx[4] = {0};

	zbook_i2c_test_emul_set_read_byte(0x5A);
	zassert_ok(zbook_i2c_read(ZBOOK_I2C_TEST_ADDR, rx, sizeof(rx)));
	for (size_t i = 0; i < sizeof(rx); i++) {
		zassert_equal(0x5A, rx[i]);
	}
}

ZTEST(zbook_i2c, test_write_read_invalid_args)
{
	uint8_t byte = 0;

	zassert_equal(-EINVAL, zbook_i2c_write_read(ZBOOK_I2C_TEST_ADDR, NULL, 1, &byte, 1));
	zassert_equal(-EINVAL, zbook_i2c_write_read(ZBOOK_I2C_TEST_ADDR, &byte, 0, &byte, 1));
	zassert_equal(-EINVAL, zbook_i2c_write_read(ZBOOK_I2C_TEST_ADDR, &byte, 1, NULL, 1));
	zassert_equal(-EINVAL, zbook_i2c_write_read(ZBOOK_I2C_TEST_ADDR, &byte, 1, &byte, 0));
}

ZTEST(zbook_i2c, test_write_read_combines_write_and_read)
{
	uint8_t reg = 0x10;
	uint8_t rx[2] = {0};
	uint8_t captured[1] = {0};

	zbook_i2c_test_emul_reset();
	zbook_i2c_test_emul_set_read_byte(0x7E);
	zassert_ok(zbook_i2c_write_read(ZBOOK_I2C_TEST_ADDR, &reg, sizeof(reg), rx, sizeof(rx)));

	zassert_equal(sizeof(reg), zbook_i2c_test_emul_last_write(captured, sizeof(captured)));
	zassert_equal(reg, captured[0]);
	zassert_equal(0x7E, rx[0]);
	zassert_equal(0x7E, rx[1]);
}

ZTEST(zbook_i2c, test_write_with_nothing_attached_fails)
{
	uint8_t byte = 0;

	zassert_not_equal(zbook_i2c_write(ZBOOK_I2C_RESERVED_ADDR, &byte, sizeof(byte)), 0,
			  "write() must fail when no device acks");
}

ZTEST(zbook_i2c, test_read_with_nothing_attached_fails)
{
	uint8_t byte = 0;

	zassert_not_equal(zbook_i2c_read(ZBOOK_I2C_RESERVED_ADDR, &byte, sizeof(byte)), 0,
			  "read() must fail when no device acks");
}

ZTEST(zbook_i2c, test_write_read_with_nothing_attached_fails)
{
	uint8_t tx = 0;
	uint8_t rx = 0;

	zassert_not_equal(
		zbook_i2c_write_read(ZBOOK_I2C_RESERVED_ADDR, &tx, sizeof(tx), &rx, sizeof(rx)), 0,
		"write_read() must fail when no device acks");
}
```

## src/zbook_i2c_loopback_emul.c
```c
/*******************************************************************
 * @file zbook_i2c_loopback_emul.c
 *
 * @brief I2C loopback emulator backing the "zbook_i2c_target" devicetree node for unit tests.
 * @author Matheus Macário dos Santos (matheus.macario@edge.ufal.br)
 * @version 0.1
 * @date 18/09/2026
 *
 * @copyright Copyright (c) Centro de Inovacao EDGE - 2026
 *
 *******************************************************************/

#include "zbook_i2c_loopback_emul.h"

#include <string.h>
#include <zephyr/device.h>
#include <zephyr/drivers/emul.h>
#include <zephyr/drivers/i2c.h>
#include <zephyr/drivers/i2c_emul.h>
#include <zephyr/sys/util.h>

#define ZBOOK_I2C_TEST_NODE DT_NODELABEL(zbook_i2c_target)
#define MAX_CAPTURE_LEN     32

struct zbook_i2c_loopback_data {
	uint8_t last_write[MAX_CAPTURE_LEN];
	size_t last_write_len;
	uint8_t read_byte;
};

static struct zbook_i2c_loopback_data emul_data;

void zbook_i2c_test_emul_reset(void)
{
	memset(&emul_data, 0, sizeof(emul_data));
}

size_t zbook_i2c_test_emul_last_write(uint8_t *out, size_t max_len)
{
	size_t len = MIN(emul_data.last_write_len, max_len);

	memcpy(out, emul_data.last_write, len);

	return len;
}

void zbook_i2c_test_emul_set_read_byte(uint8_t value)
{
	emul_data.read_byte = value;
}

static void capture_write(struct zbook_i2c_loopback_data *data, struct i2c_msg *msg)
{
	size_t len = MIN(msg->len, MAX_CAPTURE_LEN);

	memcpy(data->last_write, msg->buf, len);
	data->last_write_len = len;
}

static void fill_read(struct zbook_i2c_loopback_data *data, struct i2c_msg *msg)
{
	memset(msg->buf, data->read_byte, msg->len);
}

/* Records written bytes and answers reads with the configured byte */
static int zbook_i2c_loopback_transfer(const struct emul *target, struct i2c_msg *msgs,
				       int num_msgs, int addr)
{
	struct zbook_i2c_loopback_data *data = target->data;

	ARG_UNUSED(addr);

	if (num_msgs < 1 || num_msgs > 2) {
		return -EIO;
	}

	if (msgs[0].flags & I2C_MSG_READ) {
		fill_read(data, &msgs[0]);
	} else {
		capture_write(data, &msgs[0]);
	}

	if (num_msgs == 2) {
		if (!(msgs[1].flags & I2C_MSG_READ)) {
			return -EIO;
		}
		fill_read(data, &msgs[1]);
	}

	return 0;
}

static int zbook_i2c_loopback_init(const struct emul *target, const struct device *parent)
{
	ARG_UNUSED(target);
	ARG_UNUSED(parent);

	return 0;
}

/* No-op device required by EMUL_DT_DEFINE() for the emulated target node */
static int zbook_i2c_loopback_dev_init(const struct device *dev)
{
	ARG_UNUSED(dev);

	return 0;
}

DEVICE_DT_DEFINE(ZBOOK_I2C_TEST_NODE, zbook_i2c_loopback_dev_init, NULL, NULL, NULL, POST_KERNEL,
		 CONFIG_KERNEL_INIT_PRIORITY_DEVICE, NULL);

static const struct i2c_emul_api zbook_i2c_loopback_api = {
	.transfer = zbook_i2c_loopback_transfer,
};

EMUL_DT_DEFINE(ZBOOK_I2C_TEST_NODE, zbook_i2c_loopback_init, &emul_data, NULL,
	       &zbook_i2c_loopback_api, NULL);
```
