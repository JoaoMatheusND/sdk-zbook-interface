## CMakeLists.txt
```
# SPDX-License-Identifier: Apache-2.0
#
# Copyright (c) Centro de Inovacao EDGE - 2026

cmake_minimum_required(VERSION 3.20.0)

if(NOT DEFINED BOARD)
    set(BOARD zbook@p2/rp2350b/m33)
endif()

find_package(Zephyr REQUIRED HINTS $ENV{ZEPHYR_BASE})

project(zbook_interface)

# interface/ is auto-discovered as a Zephyr module via zephyr/module.yml --
# no add_subdirectory/glob needed here. Language-binding modules (sdk-lua,
# sdk-micropython, ...) attach the same way once added to west.yml.
```

## Kconfig
```
menu "Zephyr"
source "Kconfig.zephyr"
endmenu

module = MAIN
module-str = main
source "subsys/logging/Kconfig.template.log_config"
```

## west.yml
```
# West manifest for the ZBook interface SDK (T2 topology: this repo is both
# the manifest and the app -- interface/ is auto-discovered as a Zephyr
# module via zephyr/module.yml, no manual CMakeLists/Kconfig wiring needed).
#
#   west init -m git@github.com:zephyr-book/sdk-zbook-interface.git zbook-sdk
#   cd zbook-sdk && west update
#
# Everything west manages lands under deps/, except the board module, which is
# a sibling of this repo at the workspace root. To add a language binding
# (sdk-lua, sdk-micropython, ...), add it as a project below with
# `import: true` -- its own west.yml pulls its runtime dependencies
# transitively, and its zephyr/module.yml is auto-discovered the same way.
#
# SPDX-License-Identifier: Apache-2.0
# Copyright (c) Centro de Inovacao EDGE

manifest:
        version: "0.13"
        remotes:
                - name: zephyrproject
                  url-base: https://github.com/zephyrproject-rtos

                - name: zephyr-book
                  url-base: https://github.com/zephyr-book

        projects:
                - name: zephyr
                  remote: zephyrproject
                  revision: v4.4.2
                  west-commands: scripts/west-commands.yml
                  clone-depth: 1
                  # path-prefix below also prepends to this project's own path,
                  # so `path: zephyr` resolves to deps/zephyr.
                  path: zephyr
                  import:
                          path-prefix: deps/
                          # Only what the samples actually build against --
                          # importing all of Zephyr's modules costs several GB.
                          name-allowlist:
                                  # RP2350B SoC support and its CMSIS headers.
                                  - hal_rpi_pico
                                  - cmsis_6
                                  - picolib
                                  # LittleFS backs the persisted Wi-Fi
                                  # credentials (see bringup_p2/wifi.conf and
                                  # the board's zbook-wifi-credentials-littlefs
                                  # snippet).
                                  - littlefs
                                  # FatFs is not optional even for an app that
                                  # never touches the microSD: the board's
                                  # own defconfig sets CONFIG_FILE_SYSTEM and
                                  # CONFIG_FAT_FILESYSTEM_ELM, so the zephyr
                                  # tree compiles subsys/fs/fat_fs.c and needs
                                  # this module's ff.h.
                                  - fatfs

                # ZBook board support, shipped as a Zephyr module: it registers
                # board_root/dts_root/snippet_root via zephyr/module.yml, so
                # `-b zbook@p2/rp2350b/m33` is auto-discovered with no
                # BOARD_ROOT on the command line.
                - name: zbook
                  remote: zephyr-book
                  revision: main

        self:
                path: sdk
```

## prj.conf
```kconfig
CONFIG_GPIO=y
CONFIG_LOG=y
CONFIG_SHELL=y
CONFIG_UART_CONSOLE=n
CONFIG_ZBOOK_SPI=n
```

## src/zbook_buzzer_shell.c
```c
/*******************************************************************
 * @file zbook_buzzer_shell.c
 *
 * @brief Shell commands for the Zbook buzzer actuator, to drive it manually
 *        from a serial terminal.
 * @author José Félix de Oliveira Neto (josefelix.neto@edge.ufal.br)
 *
 * @copyright Copyright (c) 2026
 *
 *******************************************************************/

#include <string.h>

#include <zephyr/kernel.h>
#include <zephyr/shell/shell.h>
#include <zephyr/shell/shell_string_conv.h>
#include <zephyr/sys/util.h>

#include "actuators/zbook_buzzer.h"

#define NOTE_C4  262U
#define NOTE_D4  294U
#define NOTE_E4  330U
#define NOTE_F4  349U
#define NOTE_G4  392U
#define NOTE_A4  440U
#define NOTE_AS4 466U
#define NOTE_C5  523U

#define BUZZER_MUSIC_TEMPO_BPM     120U
#define BUZZER_MUSIC_WHOLE_NOTE_MS ((60000U / BUZZER_MUSIC_TEMPO_BPM) * 4U)

struct buzzer_note {
	uint32_t frequency_hz;
	uint8_t duration_divisor;
};

/* "Happy Birthday to You", in C. */
static const struct buzzer_note happy_birthday[] = {
	{NOTE_C4, 4},  {NOTE_C4, 8}, {NOTE_D4, 4}, {NOTE_C4, 4}, {NOTE_F4, 4},
	{NOTE_E4, 2},  {NOTE_C4, 4}, {NOTE_C4, 8}, {NOTE_D4, 4}, {NOTE_C4, 4},
	{NOTE_G4, 4},  {NOTE_F4, 2}, {NOTE_C4, 4}, {NOTE_C4, 8}, {NOTE_C5, 4},
	{NOTE_A4, 4},  {NOTE_F4, 4}, {NOTE_E4, 4}, {NOTE_D4, 4}, {NOTE_AS4, 4},
	{NOTE_AS4, 8}, {NOTE_A4, 4}, {NOTE_F4, 4}, {NOTE_G4, 4}, {NOTE_F4, 2},
};

static int cmd_buzzer_on(const struct shell *sh, size_t argc, char **argv)
{
	ARG_UNUSED(argc);
	ARG_UNUSED(argv);

	int ret = zbook_buzzer_on();

	if (ret != 0) {
		shell_error(sh, "zbook_buzzer_on failed: %d", ret);
		return ret;
	}

	shell_print(sh, "buzzer on");

	return 0;
}

static int cmd_buzzer_off(const struct shell *sh, size_t argc, char **argv)
{
	ARG_UNUSED(argc);
	ARG_UNUSED(argv);

	int ret = zbook_buzzer_off();

	if (ret != 0) {
		shell_error(sh, "zbook_buzzer_off failed: %d", ret);
		return ret;
	}

	shell_print(sh, "buzzer off");

	return 0;
}

static int cmd_buzzer_volume(const struct shell *sh, size_t argc, char **argv)
{
	ARG_UNUSED(argc);

	int err = 0;
	unsigned long percent = shell_strtoul(argv[1], 10, &err);

	if (err != 0 || percent > 100) {
		shell_error(sh, "usage: buzzer volume <0-100>");
		return -EINVAL;
	}

	int ret = zbook_buzzer_set_volume((uint8_t)percent);

	if (ret != 0) {
		shell_error(sh, "zbook_buzzer_set_volume failed: %d", ret);
		return ret;
	}

	shell_print(sh, "buzzer volume set to %lu%%", percent);

	return 0;
}

static int cmd_buzzer_frequency(const struct shell *sh, size_t argc, char **argv)
{
	ARG_UNUSED(argc);

	int err = 0;
	unsigned long frequency_hz = shell_strtoul(argv[1], 10, &err);

	if (err != 0) {
		shell_error(sh, "usage: buzzer frequency <hz>");
		return -EINVAL;
	}

	int ret = zbook_buzzer_set_frequency((uint32_t)frequency_hz);

	if (ret != 0) {
		shell_error(sh, "zbook_buzzer_set_frequency failed: %d", ret);
		return ret;
	}

	shell_print(sh, "buzzer frequency set to %lu Hz", frequency_hz);

	return 0;
}

static int cmd_buzzer_beep(const struct shell *sh, size_t argc, char **argv)
{
	ARG_UNUSED(argc);

	int err = 0;
	unsigned long duration_ms = shell_strtoul(argv[1], 10, &err);

	if (err != 0) {
		shell_error(sh, "usage: buzzer beep <duration_ms>");
		return -EINVAL;
	}

	shell_print(sh, "beeping for %lu ms...", duration_ms);

	int ret = zbook_buzzer_beep_ms((uint32_t)duration_ms);

	if (ret != 0) {
		shell_error(sh, "zbook_buzzer_beep_ms failed: %d", ret);
		return ret;
	}

	return 0;
}

static int cmd_buzzer_beep_repeated(const struct shell *sh, size_t argc, char **argv)
{
	ARG_UNUSED(argc);

	int err = 0;
	unsigned long times = shell_strtoul(argv[1], 10, &err);

	if (err != 0) {
		shell_error(sh, "usage: buzzer beep_repeated <times>");
		return -EINVAL;
	}

	shell_print(sh, "beeping %lu times...", times);

	int ret = zbook_buzzer_beep_repeated((uint32_t)times);

	if (ret != 0) {
		shell_error(sh, "zbook_buzzer_beep_repeated failed: %d", ret);
		return ret;
	}

	return 0;
}

static int cmd_buzzer_beep_preset(const struct shell *sh, size_t argc, char **argv)
{
	ARG_UNUSED(argc);

	enum zbook_buzzer_beep_duration length;

	if (strcmp(argv[1], "short") == 0) {
		length = ZBOOK_BUZZER_BEEP_DURATION_SHORT;
	} else if (strcmp(argv[1], "normal") == 0) {
		length = ZBOOK_BUZZER_BEEP_DURATION_NORMAL;
	} else if (strcmp(argv[1], "long") == 0) {
		length = ZBOOK_BUZZER_BEEP_DURATION_LONG;
	} else {
		shell_error(sh, "usage: buzzer beep_preset <short|normal|long>");
		return -EINVAL;
	}

	int ret = zbook_buzzer_beep(length);

	if (ret != 0) {
		shell_error(sh, "zbook_buzzer_beep failed: %d", ret);
		return ret;
	}

	shell_print(sh, "beeped (%s)", argv[1]);

	return 0;
}

static int cmd_buzzer_beep_full(const struct shell *sh, size_t argc, char **argv)
{
	ARG_UNUSED(argc);

	int err = 0;
	unsigned long duration_ms = shell_strtoul(argv[1], 10, &err);
	unsigned long times = shell_strtoul(argv[2], 10, &err);

	if (err != 0) {
		shell_error(sh, "usage: buzzer beep_full <duration_ms> <times>");
		return -EINVAL;
	}

	shell_print(sh, "beeping %lu times, %lu ms each...", times, duration_ms);

	int ret = zbook_buzzer_beep_full((uint32_t)duration_ms, (uint32_t)times);

	if (ret != 0) {
		shell_error(sh, "zbook_buzzer_beep_full failed: %d", ret);
		return ret;
	}

	return 0;
}

static int cmd_buzzer_music(const struct shell *sh, size_t argc, char **argv)
{
	ARG_UNUSED(argc);
	ARG_UNUSED(argv);

	shell_print(sh, "playing happy birthday...");

	for (size_t i = 0; i < ARRAY_SIZE(happy_birthday); i++) {
		uint32_t note_ms = BUZZER_MUSIC_WHOLE_NOTE_MS / happy_birthday[i].duration_divisor;
		uint32_t play_ms = (note_ms * 9U) / 10U;
		int ret = zbook_buzzer_set_frequency(happy_birthday[i].frequency_hz);

		if (ret != 0) {
			shell_error(sh, "zbook_buzzer_set_frequency failed: %d", ret);
			return ret;
		}

		ret = zbook_buzzer_beep_ms(play_ms);
		if (ret != 0) {
			shell_error(sh, "zbook_buzzer_beep_ms failed: %d", ret);
			return ret;
		}

		k_msleep(note_ms - play_ms);
	}

	return 0;
}

SHELL_STATIC_SUBCMD_SET_CREATE(
	sub_buzzer, SHELL_CMD_ARG(on, NULL, "Turn the buzzer on.", cmd_buzzer_on, 1, 0),
	SHELL_CMD_ARG(off, NULL, "Turn the buzzer off.", cmd_buzzer_off, 1, 0),
	SHELL_CMD_ARG(volume, NULL, "Set the buzzer volume.\nUsage: buzzer volume <0-100>",
		      cmd_buzzer_volume, 2, 0),
	SHELL_CMD_ARG(frequency, NULL, "Set the buzzer tone.\nUsage: buzzer frequency <hz>",
		      cmd_buzzer_frequency, 2, 0),
	SHELL_CMD_ARG(beep, NULL,
		      "Beep the buzzer for a duration.\n"
		      "Usage: buzzer beep <duration_ms>",
		      cmd_buzzer_beep, 2, 0),
	SHELL_CMD_ARG(beep_repeated, NULL,
		      "Beep the buzzer N times, at the normal preset duration.\n"
		      "Usage: buzzer beep_repeated <times>",
		      cmd_buzzer_beep_repeated, 2, 0),
	SHELL_CMD_ARG(beep_preset, NULL,
		      "Beep once, at a preset duration.\n"
		      "Usage: buzzer beep_preset <short|normal|long>",
		      cmd_buzzer_beep_preset, 2, 0),
	SHELL_CMD_ARG(beep_full, NULL,
		      "Beep the buzzer N times, each for a given duration.\n"
		      "Usage: buzzer beep_full <duration_ms> <times>",
		      cmd_buzzer_beep_full, 3, 0),
	SHELL_CMD_ARG(music, NULL, "Play happy birthday.", cmd_buzzer_music, 1, 0),
	SHELL_SUBCMD_SET_END);

SHELL_CMD_REGISTER(buzzer, &sub_buzzer, "ZBook buzzer actuator commands.", NULL);
```
