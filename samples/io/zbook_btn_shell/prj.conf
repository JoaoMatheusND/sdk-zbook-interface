## CMakeLists.txt
```
# SPDX-License-Identifier: Apache-2.0
#
# Copyright (c) Centro de Inovacao EDGE

cmake_minimum_required(VERSION 3.20.0)

find_package(Zephyr REQUIRED HINTS $ENV{ZEPHYR_BASE})

project(zbook_btn_shell_sample)

target_sources(app PRIVATE src/main.c src/zbook_btn_shell.c)
```

## prj.conf
```kconfig
CONFIG_SHELL=y
CONFIG_LOG=y
ZBOOK_INTERFACE_IO=]y
```

## src/main.c
```c
/************************************************************************
 * @file main.c
 *
 * @brief Entry point for the Zbook button I/O sample: initializes the
 *        buttons and exposes the `btn` shell commands to register/remove
 *        event callbacks manually.
 * @author João Matheus Nascimento Dias (joao.dias@edge.ufal.br)
 * @version 0.1
 * @date 15/09/2026
 *
 * @copyright Centro de Inovação EDGE 2026. Todos os direitos reservados.
 *
 ***********************************************************************/

#include <zephyr/kernel.h>
#include <zephyr/logging/log.h>
#include <stdio.h>

#include "io/zbook_btn.h"

LOG_MODULE_REGISTER(main);

int main(void)
{
	LOG_INF("Zbook Button I/O Sample\n");

	int ret = zbook_btn_init();

	if (ret < 0) {
		LOG_ERR("zbook_btn_init failed (%d)", ret);
	}

	return ret;
}
```

## src/zbook_btn_shell.c
```c
/************************************************************************
 * @file zbook_btn_shell.c
 *
 * @brief Shell commands for the Zbook button I/O interface, to register
 *        and remove event callbacks manually from a serial terminal.
 * @author João Matheus Nascimento Dias (joao.dias@edge.ufal.br)
 *
 * @copyright Centro de Inovação EDGE 2026. Todos os direitos reservados.
 *
 ***********************************************************************/

#include <stdlib.h>
#include <string.h>
#include <zephyr/shell/shell.h>
#include <zephyr/sys/util.h>

#include "io/zbook_btn.h"

static const struct {
	const char *name;
	enum zbook_btn_evt evt;
} evt_masks[] = {
	{"pressed", ZBOOK_BTN_EVT_PRESSED},   {"released", ZBOOK_BTN_EVT_RELEASED},
	{"long", ZBOOK_BTN_EVT_LONG_PRESSED}, {"both", ZBOOK_BTN_EVT_BOTH},
	{"all", ZBOOK_BTN_EVT_ALL},
};

static int parse_btn(const struct shell *sh, const char *arg, enum zbook_btn *btn)
{
	if (strcmp(arg, "all") == 0) {
		*btn = ZBOOK_BTN_ALL;
		return 0;
	}

	char *end;
	long n = strtol(arg, &end, 10);

	if (*end != '\0' || n < 1 || n > 4) {
		shell_error(sh, "btn invalido: %s (use 1-4 ou all)", arg);
		return -EINVAL;
	}

	*btn = (enum zbook_btn)(n - 1);
	return 0;
}

static int parse_evt_mask(const struct shell *sh, const char *arg, enum zbook_btn_evt *evt)
{
	for (size_t i = 0; i < ARRAY_SIZE(evt_masks); i++) {
		if (strcmp(arg, evt_masks[i].name) == 0) {
			*evt = evt_masks[i].evt;
			return 0;
		}
	}

	shell_error(sh, "evento invalido: %s (use pressed, released, long, both ou all)", arg);
	return -EINVAL;
}

static const char *evt_name(enum zbook_btn_evt evt)
{
	switch (evt) {
	case ZBOOK_BTN_EVT_PRESSED:
		return "pressed";
	case ZBOOK_BTN_EVT_RELEASED:
		return "released";
	case ZBOOK_BTN_EVT_LONG_PRESSED:
		return "long-pressed";
	default:
		return "unknown";
	}
}

static void shell_btn_cb(enum zbook_btn btn, enum zbook_btn_evt evt, void *user_data)
{
	const struct shell *sh = user_data;

	shell_print(sh, "BTN%d %s", btn, evt_name(evt));
}

static int cmd_btn_reg(const struct shell *sh, size_t argc, char **argv)
{
	enum zbook_btn btn;
	enum zbook_btn_evt evt;
	int ret;

	ret = parse_btn(sh, argv[1], &btn);
	if (ret < 0) {
		return ret;
	}

	ret = parse_evt_mask(sh, argv[2], &evt);
	if (ret < 0) {
		return ret;
	}

	ret = zbook_btn_reg_cb(btn, evt, shell_btn_cb, (void *)sh);
	if (ret < 0) {
		shell_error(sh, "zbook_btn_reg_cb falhou (%d)", ret);
		return ret;
	}

	return 0;
}

static int cmd_btn_rm(const struct shell *sh, size_t argc, char **argv)
{
	enum zbook_btn btn;
	int ret;

	ret = parse_btn(sh, argv[1], &btn);
	if (ret < 0) {
		return ret;
	}

	ret = zbook_btn_rm_cb(btn);
	if (ret < 0) {
		shell_error(sh, "zbook_btn_rm_cb falhou (%d)", ret);
		return ret;
	}

	return 0;
}

SHELL_STATIC_SUBCMD_SET_CREATE(sub_btn,
			       SHELL_CMD_ARG(reg, NULL,
					     "btn reg <1-4|all> <pressed|released|long|both|all>",
					     cmd_btn_reg, 3, 0),
			       SHELL_CMD_ARG(rm, NULL, "btn rm <1-4|all>", cmd_btn_rm, 2, 0),
			       SHELL_SUBCMD_SET_END);

SHELL_CMD_REGISTER(btn, &sub_btn, "Zbook button I/O commands", NULL);
```
